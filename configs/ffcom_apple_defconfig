## configs/ffcom_apple_defconfig
```kconfig
CONFIG_RISCV=y
# CONFIG_RISCV_ISA_C is not set
CONFIG_NR_DRAM_BANKS=1
CONFIG_ENV_SIZE=0x20000
CONFIG_TARGET_FFCOM_APPLE=y
CONFIG_ARCH_RV64I=y
CONFIG_DISTRO_DEFAULTS=y
CONFIG_FIT=y
CONFIG_DISPLAY_CPUINFO=y
CONFIG_DISPLAY_BOARDINFO=y
CONFIG_OF_EMBED=y
CONFIG_DEFAULT_DEVICE_TREE="ffcom-apple"
CONFIG_XIP=y
CONFIG_SHOW_REGS=y
# CONFIG_CMD_BOOTEFI_HELLO is not set
# CONFIG_CMD_BOOTEFI_SELFTEST is not set
# CONFIG_CMD_MII is not set
CONFIG_SYS_RELOC_GD_ENV_ADDR=y
CONFIG_DM_MTD=y

CONFIG_SYS_TEXT_BASE=0x80
CONFIG_BAUDRATE=115200

CONFIG_CMD_MEMTEST=y
CONFIG_SYS_ALT_MEMTEST=y
CONFIG_SYS_ALT_MEMTEST_BITFLIP=y
CONFIG_SYS_MEMTEST_START=0
CONFIG_SYS_MEMTEST_END=0x1000
```
